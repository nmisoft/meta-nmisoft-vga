## conf/layer.conf
```bitbake
# We have a conf and classes directory, add to BBPATH
BBPATH .= ":${LAYERDIR}"

# We have recipes-* directories, add to BBFILES
BBFILES += "${LAYERDIR}/recipes-*/*/*.bb \
            ${LAYERDIR}/recipes-*/*/*.bbappend"

BBFILE_COLLECTIONS += "meta-nmisoft-vga"
BBFILE_PATTERN_meta-nmisoft-vga = "^${LAYERDIR}/"
BBFILE_PRIORITY_meta-nmisoft-vga = "6"

LAYERDEPENDS_meta-nmisoft-vga = "core"
LAYERSERIES_COMPAT_meta-nmisoft-vga = "dunfell"

PREFERRED_PROVIDER_virtual/kernel = "linux-ti-staging"
MACHINE = "beaglebone"
```
